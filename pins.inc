// Auto-generated by extras/pinfinder.py. Do not edit manually.
// Source tables: extras/spipinmux/SAMD21_Table_7-1.csv, extras/spipinmux/SAMD51_Table_6-1.csv

// Device-series macros (Wire-style gating pattern).
#ifndef SAMD21_DA1_32_SERIES
#if defined(__SAMD21E15A__) || defined(__SAMD21E15B__) || defined(__SAMD21E15C__) || defined(__SAMD21E15L__) || defined(__SAMD21E16A__) || defined(__SAMD21E16B__) || defined(__SAMD21E16C__) || defined(__SAMD21E16L__) || defined(__SAMD21E17A__) || defined(__SAMD21E17D__) || defined(__SAMD21E17L__) || defined(__SAMD21E18A__) || defined(__SAMDA1E14B__) || defined(__SAMDA1E15B__) || defined(__SAMDA1E16B__)
#define SAMD21_DA1_32_SERIES 1
#else
#define SAMD21_DA1_32_SERIES 0
#endif
#endif

#ifndef SAMD21_DA1_48_SERIES
#if defined(__SAMD21G15A__) || defined(__SAMD21G15B__) || defined(__SAMD21G16A__) || defined(__SAMD21G16B__) || defined(__SAMD21G16L__) || defined(__SAMD21G17A__) || defined(__SAMD21G17D__) || defined(__SAMD21G17L__) || defined(__SAMD21G18A__) || defined(__SAMDA1G14B__) || defined(__SAMDA1G15B__) || defined(__SAMDA1G16B__)
#define SAMD21_DA1_48_SERIES 1
#else
#define SAMD21_DA1_48_SERIES 0
#endif
#endif

#ifndef SAMD21_DA1_64_SERIES
#if defined(__SAMD21J15A__) || defined(__SAMD21J15B__) || defined(__SAMD21J16A__) || defined(__SAMD21J16B__) || defined(__SAMD21J17A__) || defined(__SAMD21J17D__) || defined(__SAMD21J18A__) || defined(__SAMDA1J14B__) || defined(__SAMDA1J15B__) || defined(__SAMDA1J16B__)
#define SAMD21_DA1_64_SERIES 1
#else
#define SAMD21_DA1_64_SERIES 0
#endif
#endif

#ifndef SAMD5X_E5X_48_SERIES
#if defined(__SAMD51G18A__) || defined(__SAMD51G19A__) || defined(__SAME51G18A__) || defined(__SAME51G19A__)
#define SAMD5X_E5X_48_SERIES 1
#else
#define SAMD5X_E5X_48_SERIES 0
#endif
#endif

#ifndef SAMD5X_E5X_64_SERIES
#if defined(__SAMD51J18A__) || defined(__SAMD51J19A__) || defined(__SAMD51J20A__) || defined(__SAME51J18A__) || defined(__SAME51J19A__) || defined(__SAME51J20A__) || defined(__SAME53J18A__) || defined(__SAME53J19A__) || defined(__SAME53J20A__)
#define SAMD5X_E5X_64_SERIES 1
#else
#define SAMD5X_E5X_64_SERIES 0
#endif
#endif

#ifndef SAMD5X_E5X_100_SERIES
#if defined(__SAMD51N19A__) || defined(__SAMD51N20A__) || defined(__SAME51N19A__) || defined(__SAME51N20A__) || defined(__SAME53N19A__) || defined(__SAME53N20A__) || defined(__SAME54N19A__) || defined(__SAME54N20A__)
#define SAMD5X_E5X_100_SERIES 1
#else
#define SAMD5X_E5X_100_SERIES 0
#endif
#endif

#ifndef SAMD5X_E5X_120_SERIES
#if defined(__SAMD51P19A__) || defined(__SAMD51P20A__) || defined(__SAME54P19A__) || defined(__SAME54P20A__)
#define SAMD5X_E5X_120_SERIES 1
#else
#define SAMD5X_E5X_120_SERIES 0
#endif
#endif

// SAMD21 / DA1: shared routes then pin-count extras.
// SAMD21/DA1 shared E(32)+G(48)+J(64) routes
#if SAMD21_DA1_32_SERIES || SAMD21_DA1_48_SERIES || SAMD21_DA1_64_SERIES
    // SERCOM0 / MUX C
SERCOM_PIN(0, 8, 0, 0, 2)  // PA08C
SERCOM_PIN(0, 10, 0, 2, 2) // PA10C
SERCOM_PIN(0, 11, 0, 3, 2) // PA11C

    // SERCOM0 / MUX D
SERCOM_PIN(0, 4, 0, 0, 3)  // PA04D
SERCOM_PIN(0, 6, 0, 2, 3)  // PA06D
SERCOM_PIN(0, 7, 0, 3, 3)  // PA07D

    // SERCOM1 / MUX C
SERCOM_PIN(0, 16, 1, 0, 2) // PA16C
SERCOM_PIN(0, 18, 1, 2, 2) // PA18C
SERCOM_PIN(0, 19, 1, 3, 2) // PA19C

    // SERCOM1 / MUX D
SERCOM_PIN(0, 0, 1, 0, 3)  // PA00D
SERCOM_PIN(0, 30, 1, 2, 3) // PA30D
SERCOM_PIN(0, 31, 1, 3, 3) // PA31D

    // SERCOM2 / MUX C
SERCOM_PIN(0, 14, 2, 2, 2) // PA14C
SERCOM_PIN(0, 15, 2, 3, 2) // PA15C

    // SERCOM2 / MUX D
SERCOM_PIN(0, 8, 2, 0, 3)  // PA08D
SERCOM_PIN(0, 10, 2, 2, 3) // PA10D
SERCOM_PIN(0, 11, 2, 3, 3) // PA11D

    // SERCOM3 / MUX C
SERCOM_PIN(0, 22, 3, 0, 2) // PA22C
SERCOM_PIN(0, 24, 3, 2, 2) // PA24C
SERCOM_PIN(0, 25, 3, 3, 2) // PA25C

    // SERCOM3 / MUX D
SERCOM_PIN(0, 16, 3, 0, 3) // PA16D
SERCOM_PIN(0, 18, 3, 2, 3) // PA18D
SERCOM_PIN(0, 19, 3, 3, 3) // PA19D

    // SERCOM4 / MUX D
SERCOM_PIN(0, 14, 4, 2, 3) // PA14D
SERCOM_PIN(0, 15, 4, 3, 3) // PA15D

    // SERCOM5 / MUX D
SERCOM_PIN(0, 22, 5, 0, 3) // PA22D
SERCOM_PIN(0, 24, 5, 2, 3) // PA24D
SERCOM_PIN(0, 25, 5, 3, 3) // PA25D
#endif

// SAMD21/DA1 48-pin and larger extra routes
#if SAMD21_DA1_48_SERIES || SAMD21_DA1_64_SERIES
    // SERCOM2 / MUX C
SERCOM_PIN(0, 12, 2, 0, 2) // PA12C

    // SERCOM3 / MUX D
SERCOM_PIN(0, 20, 3, 2, 3) // PA20D
SERCOM_PIN(0, 21, 3, 3, 3) // PA21D

    // SERCOM4 / MUX D
SERCOM_PIN(0, 12, 4, 0, 3) // PA12D
SERCOM_PIN(1, 8, 4, 0, 3)  // PB08D
SERCOM_PIN(1, 10, 4, 2, 3) // PB10D
SERCOM_PIN(1, 11, 4, 3, 3) // PB11D

    // SERCOM5 / MUX C
SERCOM_PIN(0, 20, 5, 2, 2) // PA20C
SERCOM_PIN(0, 21, 5, 3, 2) // PA21C

    // SERCOM5 / MUX D
SERCOM_PIN(1, 2, 5, 0, 3)  // PB02D
SERCOM_PIN(1, 22, 5, 2, 3) // PB22D
SERCOM_PIN(1, 23, 5, 3, 3) // PB23D
#endif

// SAMD21/DA1 64-pin extra routes
#if SAMD21_DA1_64_SERIES
    // SERCOM4 / MUX C
SERCOM_PIN(1, 12, 4, 0, 2) // PB12C
SERCOM_PIN(1, 14, 4, 2, 2) // PB14C
SERCOM_PIN(1, 15, 4, 3, 2) // PB15C

    // SERCOM5 / MUX C
SERCOM_PIN(1, 16, 5, 0, 2) // PB16C

    // SERCOM5 / MUX D
SERCOM_PIN(1, 0, 5, 2, 3)  // PB00D
SERCOM_PIN(1, 1, 5, 3, 3)  // PB01D
SERCOM_PIN(1, 30, 5, 0, 3) // PB30D
#endif

// SAMD51 / SAME5x: shared routes then pin-count extras.
// SAMD5x/E5x shared 48-pin+ routes
#if SAMD5X_E5X_48_SERIES || SAMD5X_E5X_64_SERIES || SAMD5X_E5X_100_SERIES || SAMD5X_E5X_120_SERIES
    // SERCOM0 / MUX C
SERCOM_PIN(0, 8, 0, 0, 2)  // PA08C
SERCOM_PIN(0, 10, 0, 2, 2) // PA10C
SERCOM_PIN(0, 11, 0, 3, 2) // PA11C

    // SERCOM0 / MUX D
SERCOM_PIN(0, 4, 0, 0, 3)  // PA04D
SERCOM_PIN(0, 6, 0, 2, 3)  // PA06D
SERCOM_PIN(0, 7, 0, 3, 3)  // PA07D

    // SERCOM1 / MUX C
SERCOM_PIN(0, 16, 1, 0, 2) // PA16C
SERCOM_PIN(0, 18, 1, 2, 2) // PA18C
SERCOM_PIN(0, 19, 1, 3, 2) // PA19C
SERCOM_PIN(1, 22, 1, 2, 2) // PB22C
SERCOM_PIN(1, 23, 1, 3, 2) // PB23C

    // SERCOM1 / MUX D
SERCOM_PIN(0, 0, 1, 0, 3)  // PA00D
SERCOM_PIN(0, 30, 1, 2, 3) // PA30D
SERCOM_PIN(0, 31, 1, 3, 3) // PA31D

    // SERCOM2 / MUX C
SERCOM_PIN(0, 12, 2, 0, 2) // PA12C
SERCOM_PIN(0, 14, 2, 2, 2) // PA14C
SERCOM_PIN(0, 15, 2, 3, 2) // PA15C

    // SERCOM2 / MUX D
SERCOM_PIN(0, 9, 2, 0, 3)  // PA09D
SERCOM_PIN(0, 10, 2, 2, 3) // PA10D
SERCOM_PIN(0, 11, 2, 3, 3) // PA11D

    // SERCOM3 / MUX C
SERCOM_PIN(0, 22, 3, 0, 2) // PA22C
SERCOM_PIN(0, 24, 3, 2, 2) // PA24C
SERCOM_PIN(0, 25, 3, 3, 2) // PA25C

    // SERCOM3 / MUX D
SERCOM_PIN(0, 17, 3, 0, 3) // PA17D
SERCOM_PIN(0, 18, 3, 2, 3) // PA18D
SERCOM_PIN(0, 19, 3, 3, 3) // PA19D
SERCOM_PIN(0, 20, 3, 2, 3) // PA20D
SERCOM_PIN(0, 21, 3, 3, 3) // PA21D

    // SERCOM4 / MUX D
SERCOM_PIN(0, 13, 4, 0, 3) // PA13D
SERCOM_PIN(0, 14, 4, 2, 3) // PA14D
SERCOM_PIN(0, 15, 4, 3, 3) // PA15D
SERCOM_PIN(1, 8, 4, 0, 3)  // PB08D
SERCOM_PIN(1, 10, 4, 2, 3) // PB10D
SERCOM_PIN(1, 11, 4, 3, 3) // PB11D

    // SERCOM5 / MUX C
SERCOM_PIN(0, 20, 5, 2, 2) // PA20C
SERCOM_PIN(0, 21, 5, 3, 2) // PA21C

    // SERCOM5 / MUX D
SERCOM_PIN(0, 23, 5, 0, 3) // PA23D
SERCOM_PIN(0, 24, 5, 2, 3) // PA24D
SERCOM_PIN(0, 25, 5, 3, 3) // PA25D
SERCOM_PIN(1, 2, 5, 0, 3)  // PB02D
SERCOM_PIN(1, 22, 5, 2, 3) // PB22D
SERCOM_PIN(1, 23, 5, 3, 3) // PB23D

    // SERCOM7 / MUX C
SERCOM_PIN(0, 30, 7, 2, 2) // PA30C
SERCOM_PIN(0, 31, 7, 3, 2) // PA31C
#endif

// SAMD5x/E5x 64-pin and larger extra routes
#if SAMD5X_E5X_64_SERIES || SAMD5X_E5X_100_SERIES || SAMD5X_E5X_120_SERIES
    // SERCOM4 / MUX C
SERCOM_PIN(1, 12, 4, 0, 2) // PB12C
SERCOM_PIN(1, 14, 4, 2, 2) // PB14C
SERCOM_PIN(1, 15, 4, 3, 2) // PB15C

    // SERCOM5 / MUX C
SERCOM_PIN(1, 16, 5, 0, 2) // PB16C

    // SERCOM5 / MUX D
SERCOM_PIN(1, 0, 5, 2, 3)  // PB00D
SERCOM_PIN(1, 1, 5, 3, 3)  // PB01D
SERCOM_PIN(1, 31, 5, 0, 3) // PB31D

    // SERCOM7 / MUX C
SERCOM_PIN(1, 30, 7, 0, 2) // PB30C
#endif

// SAMD5x/E5x 100-pin and larger extra routes
#if SAMD5X_E5X_100_SERIES || SAMD5X_E5X_120_SERIES
    // SERCOM0 / MUX C
SERCOM_PIN(1, 24, 0, 0, 2) // PB24C
SERCOM_PIN(2, 24, 0, 2, 2) // PC24C
SERCOM_PIN(2, 25, 0, 3, 2) // PC25C

    // SERCOM0 / MUX D
SERCOM_PIN(2, 17, 0, 0, 3) // PC17D
SERCOM_PIN(2, 18, 0, 2, 3) // PC18D
SERCOM_PIN(2, 19, 0, 3, 3) // PC19D

    // SERCOM1 / MUX C
SERCOM_PIN(2, 22, 1, 0, 2) // PC22C
SERCOM_PIN(2, 27, 1, 0, 2) // PC27C
SERCOM_PIN(3, 20, 1, 2, 2) // PD20C
SERCOM_PIN(3, 21, 1, 3, 2) // PD21C

    // SERCOM2 / MUX C
SERCOM_PIN(1, 26, 2, 0, 2) // PB26C
SERCOM_PIN(1, 28, 2, 2, 2) // PB28C
SERCOM_PIN(1, 29, 2, 3, 2) // PB29C

    // SERCOM2 / MUX D
SERCOM_PIN(1, 25, 2, 0, 3) // PB25D
SERCOM_PIN(2, 24, 2, 2, 3) // PC24D
SERCOM_PIN(2, 25, 2, 3, 3) // PC25D

    // SERCOM3 / MUX C
SERCOM_PIN(1, 20, 3, 0, 2) // PB20C

    // SERCOM3 / MUX D
SERCOM_PIN(2, 23, 3, 0, 3) // PC23D
SERCOM_PIN(3, 20, 3, 2, 3) // PD20D
SERCOM_PIN(3, 21, 3, 3, 3) // PD21D

    // SERCOM4 / MUX D
SERCOM_PIN(1, 27, 4, 0, 3) // PB27D
SERCOM_PIN(1, 28, 4, 2, 3) // PB28D
SERCOM_PIN(1, 29, 4, 3, 3) // PB29D

    // SERCOM5 / MUX C
SERCOM_PIN(1, 18, 5, 2, 2) // PB18C
SERCOM_PIN(1, 19, 5, 3, 2) // PB19C

    // SERCOM6 / MUX C
SERCOM_PIN(2, 4, 6, 0, 2)  // PC04C
SERCOM_PIN(2, 6, 6, 2, 2)  // PC06C
SERCOM_PIN(2, 7, 6, 3, 2)  // PC07C
SERCOM_PIN(2, 10, 6, 2, 2) // PC10C
SERCOM_PIN(2, 11, 6, 3, 2) // PC11C
SERCOM_PIN(2, 16, 6, 0, 2) // PC16C
SERCOM_PIN(2, 18, 6, 2, 2) // PC18C
SERCOM_PIN(2, 19, 6, 3, 2) // PC19C

    // SERCOM6 / MUX D
SERCOM_PIN(2, 13, 6, 0, 3) // PC13D
SERCOM_PIN(2, 14, 6, 2, 3) // PC14D
SERCOM_PIN(2, 15, 6, 3, 3) // PC15D
SERCOM_PIN(3, 9, 6, 0, 3)  // PD09D
SERCOM_PIN(3, 10, 6, 2, 3) // PD10D
SERCOM_PIN(3, 11, 6, 3, 3) // PD11D

    // SERCOM7 / MUX C
SERCOM_PIN(2, 12, 7, 0, 2) // PC12C
SERCOM_PIN(2, 14, 7, 2, 2) // PC14C
SERCOM_PIN(2, 15, 7, 3, 2) // PC15C
SERCOM_PIN(3, 8, 7, 0, 2)  // PD08C
SERCOM_PIN(3, 10, 7, 2, 2) // PD10C
SERCOM_PIN(3, 11, 7, 3, 2) // PD11C

    // SERCOM7 / MUX D
SERCOM_PIN(1, 18, 7, 2, 3) // PB18D
SERCOM_PIN(1, 19, 7, 3, 3) // PB19D
SERCOM_PIN(1, 21, 7, 0, 3) // PB21D
SERCOM_PIN(2, 10, 7, 2, 3) // PC10D
SERCOM_PIN(2, 11, 7, 3, 3) // PC11D
#endif

// SAMD5x/E5x 120/128-pin extra routes
#if SAMD5X_E5X_120_SERIES
#endif
